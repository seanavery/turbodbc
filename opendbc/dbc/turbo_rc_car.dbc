VERSION "0.0.01"

BO_ 514 STEER_CMD: 2 XXX
  SG_ STEER_ANGLE : 0|16@1+ (1,0) [60|120] "degrees" Vector__XXX

BO_ 515 THROTTLE_CMD: 2 XXX
  SG_ THROTTLE : 0|16@1+ (0.1,0) [0|100] "percent" Vector__XXX
